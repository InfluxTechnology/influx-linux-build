VERSION ""

NS_ :

BS_:

BU_: QP_GNSS

BO_ 768 Latitude/Longitude: 8 QP_GNSS
 SG_ Longitude : 32|32@1- (1,0) [-180|180] "deg" Vector__XXX
 SG_ Latitude : 0|32@1- (1,0) [-90|90] "deg" Vector__XXX

BO_ 769 Altitude/Satelites: 8 QP_GNSS
 SG_ NumberOfSatelitesUsed : 32|32@1- (1,0) [0|12] "-" Vector__XXX
 SG_ AltitudeAboveMeanSeaLevel : 0|32@1- (1,0) [0|100000] "m" Vector__XXX

BO_ 770 Speed/Course: 8 QP_GNSS
 SG_ SpeedOverGround : 0|32@1- (1,0) [0|15550.75] "knots" Vector__XXX
 SG_ CourseOverGround : 32|32@1- (1,0) [0|360] "deg" Vector__XXX

SIG_VALTYPE_ 768 Longitude : 1;
SIG_VALTYPE_ 768 Latitude : 1;
SIG_VALTYPE_ 769 NumberOfSatelitesUsed : 1;
SIG_VALTYPE_ 769 AltitudeAboveMeanSeaLevel : 1;
SIG_VALTYPE_ 770 SpeedOverGround : 1;
SIG_VALTYPE_ 770 CourseOverGround : 1;
