VERSION ""

NS_ :

BS_:

BU_: QP_AdcDig

BO_ 294 Digital: 6 QP_AdcDig
 SG_ Digital_1 : 16|8@1+ (1,0) [0|1] "" Vector__XXX
 SG_ Digital_0 : 0|8@1+ (1,0) [0|1] "" Vector__XXX

BO_ 295 Analog: 8 QP_AdcDig
 SG_ ADC_1 : 32|32@1- (1,0) [0|10] "V" Vector__XXX
 SG_ ADC_0 : 0|32@1- (1,0) [0|10] "V" Vector__XXX

BO_ 293 Analog: 8 QP_AdcDig
 SG_ ADC_3 : 32|32@1- (1,0) [0|10] "V" Vector__XXX
 SG_ ADC_2 : 0|32@1- (1,0) [0|31] "V" Vector__XXX

SIG_VALTYPE_ 295 ADC_1 : 1;
SIG_VALTYPE_ 295 ADC_0 : 1;

SIG_VALTYPE_ 293 ADC_3 : 1;
SIG_VALTYPE_ 293 ADC_2 : 1;
