## sources/meta-ea-mender/conf/layer.conf
```bitbake
# We have a conf and classes directory, add to BBPATH
BBPATH .= ":${LAYERDIR}"

# We have a recipes directory, add to BBFILES
BBFILES += "${LAYERDIR}/recipes-*/*/*.bb \
            ${LAYERDIR}/recipes-*/*/*.bbappend"

BBFILE_COLLECTIONS += "ea-mender"
BBFILE_PATTERN_ea-mender = "^${LAYERDIR}/"
BBFILE_PRIORITY_ea-mender = "11"
LAYERSERIES_COMPAT_ea-mender = "zeus"

LAYERDEPENDS_mender-coral = "mender ea"
```

## sources/meta-influx/recipes-image/conf/layer.conf
```bitbake
# We have a conf and classes directory, add to BBPATH
BBPATH .= ":${LAYERDIR}"

# We have recipes-* directories, add to BBFILES
BBFILES += "${LAYERDIR}/recipes-*/*/*.bb \
            ${LAYERDIR}/recipes-*/*/*.bbappend"

BBFILE_COLLECTIONS += "image-install"
BBFILE_PATTERN_image-install = "^${LAYERDIR}/"
BBFILE_PRIORITY_image-install = "6"

LAYERDEPENDS_image-install = "core"
LAYERSERIES_COMPAT_image-install = "warrior zeus"
```

## sources/meta-influx/recipes-influx/conf/layer.conf
```bitbake
# We have a conf and classes directory, add to BBPATH
BBPATH .= ":${LAYERDIR}"

# We have recipes-* directories, add to BBFILES
BBFILES += "${LAYERDIR}/recipes-*/*/*.bb \
            ${LAYERDIR}/recipes-*/*/*.bbappend"

BBFILE_COLLECTIONS += "influx-files"
BBFILE_PATTERN_influx-files = "^${LAYERDIR}/"
BBFILE_PRIORITY_influx-files = "6"

LAYERDEPENDS_influx-files = "core"
LAYERSERIES_COMPAT_influx-files = "warrior zeus"
```

## sources/meta-influx/recipes-modules/conf/layer.conf
```bitbake
# We have a conf and classes directory, add to BBPATH
BBPATH .= ":${LAYERDIR}"

# We have recipes-* directories, add to BBFILES
BBFILES += "${LAYERDIR}/recipes-*/*/*.bb \
            ${LAYERDIR}/recipes-*/*/*.bbappend"

BBFILE_COLLECTIONS += "kernel-modules"
BBFILE_PATTERN_kernel-modules = "^${LAYERDIR}/"
BBFILE_PRIORITY_kernel-modules = "6"

LAYERDEPENDS_kernel-modules = "core"
LAYERSERIES_COMPAT_kernel-modules = "warrior zeus"
```
